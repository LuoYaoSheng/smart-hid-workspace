## smart-hid-firmware/components/led_manager/Kconfig
```kconfig
# led_manager Kconfig — 板载状态 LED
menu "Smart HID LED"

choice SMART_HID_LED_TYPE
    prompt "板载状态 LED 类型"
    default SMART_HID_LED_TYPE_WS2812
    help
        WS2812：ESP32-S3 开发板常见板载 RGB 灯（DevKitC-1 默认 GPIO48，部分批次 GPIO38），
        颜色 + 节奏双语义。
        SIMPLE：单色 GPIO LED，仅节奏语义（不同状态用不同闪烁模式区分）。

config SMART_HID_LED_TYPE_NONE
    bool "无 LED（禁用组件）"
config SMART_HID_LED_TYPE_SIMPLE
    bool "单色 GPIO LED"
config SMART_HID_LED_TYPE_WS2812
    bool "WS2812 RGB LED"
endchoice

config SMART_HID_LED_GPIO
    int "LED GPIO 编号"
    default 48
    help
        WS2812：ESP32-S3-DevKitC-1 为 GPIO48（部分批次 GPIO38），按载板实际调整。
        单色 LED：按载板原理图。

config SMART_HID_LED_SIMPLE_ACTIVE_LOW
    bool "单色 LED 低电平点亮"
    default n
    depends on SMART_HID_LED_TYPE_SIMPLE

config SMART_HID_LED_WS2812_BRIGHTNESS
    int "WS2812 亮度（1-255）"
    default 32
    range 1 255
    depends on SMART_HID_LED_TYPE_WS2812

config SMART_HID_LED_PULSE_MS
    int "命令执行成功脉冲时长（ms）"
    default 150
    range 50 1000

endmenu
```

## smart-hid-firmware/main/Kconfig.projbuild
```kconfig
menu "Smart HID"

config SMART_HID_DEVICE_ID
    string "Device ID（首次烧录后由 NVS 接管）"
    default "HID-00000001"
    help
        仅首次启动使用（NVS 未写入时）。后续 device_id 持久化在 NVS namespace=identity。
        格式：^HID-[A-Z0-9]{8}$

config SMART_HID_DEV_STATIC_CONFIG
    bool "DEV ONLY — Kconfig 静态网络配置 fallback"
    default n
    help
        DEV ONLY / NOT PRODUCTION DEFAULT。显式开启后：无 NVS active 配置时
        使用下面 Kconfig 的 Wi-Fi/MQTT 参数连接（仅内存，绝不写 NVS、绝不覆盖
        BLE 配置）。生产固件必须保持 n（默认进 BLE Provision Mode）。
        DEV 模式下 MQTT 账号需与 ControlHub config.yaml 显式配置的
        mqtt.username/password 一致（ControlHub 内部凭据默认每启动随机生成）。

config SMART_HID_WIFI_SSID
    string "DEV Wi-Fi SSID（仅 SMART_HID_DEV_STATIC_CONFIG=y 时使用）"
    default ""

config SMART_HID_WIFI_PASSWORD
    string "DEV Wi-Fi password（仅 DEV 静态模式；绝不写日志）"
    default ""

config SMART_HID_MQTT_BROKER_HOST
    string "DEV MQTT broker host（仅 SMART_HID_DEV_STATIC_CONFIG=y 时使用）"
    default "192.168.1.100"

config SMART_HID_MQTT_BROKER_PORT
    int "DEV MQTT broker port"
    default 17891

config SMART_HID_MQTT_USERNAME
    string "DEV MQTT username（配对设备应为空；DEV 模式填 hub 显式配置的账号）"
    default ""

config SMART_HID_MQTT_PASSWORD
    string "DEV MQTT password（绝不写日志）"
    default ""

config SMART_HID_USB_HID_MOUSE_REPORT_ID
    int "USB Mouse HID report ID"
    default 1

config SMART_HID_USB_HID_KEYBOARD_REPORT_ID
    int "USB Keyboard HID report ID"
    default 2

config SMART_HID_STATUS_HEARTBEAT_SEC
    int "Status 心跳周期（秒）"
    default 10

endmenu
```
